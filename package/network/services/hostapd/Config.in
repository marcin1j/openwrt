## package/network/services/hostapd/Config.in
```kconfig
# wpa_supplicant config
config WPA_SUPPLICANT_NO_TIMESTAMP_CHECK
	bool "Disable timestamp check"
	depends on PACKAGE_wpa-supplicant || PACKAGE_wpa-supplicant-mesh || PACKAGE_wpa-supplicant-mini || PACKAGE_wpa-supplicant-custom || PACKAGE_wpad || PACKAGE_wpad-mini || PACKAGE_wpad-mesh || PACKAGE_wpad-custom
	default n
	help
	  This disables the timestamp check for certificates in wpa_supplicant
	  Useful for devices without RTC that cannot reliably get the real date/time

choice
	prompt "Choose TLS provider"
	default WPA_SUPPLICANT_INTERNAL
	depends on PACKAGE_wpa-supplicant || PACKAGE_wpad

config WPA_SUPPLICANT_INTERNAL
	bool "internal"

config WPA_SUPPLICANT_OPENSSL
	bool "openssl"
	select PACKAGE_libopenssl

endchoice


config WPA_RFKILL_SUPPORT
	bool "Add rfkill support"
	depends on PACKAGE_wpa-supplicant || PACKAGE_wpa-supplicant-mesh || PACKAGE_wpa-supplicant-mini || PACKAGE_wpa-supplicant-custom || PACKAGE_wpad || PACKAGE_wpad-mini || PACKAGE_wpad-mesh || PACKAGE_wpad-custom
	default n

config WPA_MSG_MIN_PRIORITY
	int "Minimum debug message priority"
	default 3
	help
	  Useful values are:
	    0 = all messages
		1 = raw message dumps
		2 = most debugging messages
		3 = info messages
		4 = warnings
		5 = errors


menu "Configure wpad/wpa-supplicant custom features"
	depends on PACKAGE_wpa-supplicant-custom || PACKAGE_wpad-custom

	config WPA_ROAMING
	bool "Enable 802.11r fast BSS transition"
	default y
	help
	  Increases binary size by about 12KiB (uncompressed)

endmenu

config DRIVER_WEXT_SUPPORT
	bool
	default n

config DRIVER_11N_SUPPORT
	bool
	default n

config DRIVER_11AC_SUPPORT
	bool
	default n

config DRIVER_11W_SUPPORT
	bool
	default n
```
