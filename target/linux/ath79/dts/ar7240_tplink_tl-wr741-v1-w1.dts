// SPDX-License-Identifier: GPL-2.0-or-later OR MIT
/dts-v1/;

#include "ar7240_tplink_tl-wr.dtsi"

/ {
	model = "TP-Link TL-WR741N/ND v1/v2 w1";
	compatible = "tplink,tl-wr741-v1", "qca,ar7240";

	keys {
		/delete-node/ reset;
	};

	onewire {
		compatible = "w1-gpio";
		gpios = <&gpio 11 GPIO_ACTIVE_HIGH>;
		linux,open-drain = <1>;
	};
};


